## main/Kconfig.projbuild
```kconfig
menu "Leveller Configuration"

    menu "Display Configuration"
        config LEVELLER_LCD_H_RES
            int "LCD Horizontal Resolution"
            default 320
            help
                Horizontal resolution of the LCD display.

        config LEVELLER_LCD_V_RES
            int "LCD Vertical Resolution"
            default 240
            help
                Vertical resolution of the LCD display.

        config LEVELLER_LCD_SPI_CLOCK_HZ
            int "LCD SPI Clock Frequency (Hz)"
            default 40000000
            range 1000000 80000000
            help
                SPI clock frequency for LCD (default: 40MHz).
                Reduce if seeing display artifacts.

        config LEVELLER_LCD_BIT_PER_PIXEL
            int "LCD Color Depth (bits per pixel)"
            default 16
            help
                Color depth for LCD (16 = RGB565).
    endmenu

    menu "Touch Configuration"
        config LEVELLER_TOUCH_SPI_CLOCK_HZ
            int "Touch SPI Clock Frequency (Hz)"
            default 2000000
            range 100000 10000000
            help
                SPI clock frequency for XPT2046 touch controller.
    endmenu

    menu "Pin Configuration"
        comment "TFT Display Pins"

        config LEVELLER_LCD_PIN_MOSI
            int "LCD MOSI Pin"
            default 12
            help
                GPIO pin for LCD SPI MOSI (data out).

        config LEVELLER_LCD_PIN_CLK
            int "LCD Clock Pin"
            default 2
            help
                GPIO pin for LCD SPI clock.

        config LEVELLER_LCD_PIN_CS
            int "LCD Chip Select Pin"
            default 13
            help
                GPIO pin for LCD chip select.

        config LEVELLER_LCD_PIN_DC
            int "LCD Data/Command Pin"
            default 15
            help
                GPIO pin for LCD data/command select.

        config LEVELLER_LCD_PIN_RST
            int "LCD Reset Pin"
            default 14
            help
                GPIO pin for LCD reset (-1 if not connected).

        config LEVELLER_LCD_PIN_BACKLIGHT
            int "LCD Backlight Pin"
            default -1
            help
                GPIO pin for LCD backlight control (-1 if not used).

        comment "Touch Controller Pins"

        config LEVELLER_TOUCH_PIN_MOSI
            int "Touch MOSI Pin"
            default 32
            help
                GPIO pin for touch SPI MOSI.

        config LEVELLER_TOUCH_PIN_MISO
            int "Touch MISO Pin"
            default 36
            help
                GPIO pin for touch SPI MISO.

        config LEVELLER_TOUCH_PIN_CLK
            int "Touch Clock Pin"
            default 25
            help
                GPIO pin for touch SPI clock.

        config LEVELLER_TOUCH_PIN_CS
            int "Touch Chip Select Pin"
            default 33
            help
                GPIO pin for touch chip select.

        config LEVELLER_TOUCH_PIN_IRQ
            int "Touch Interrupt Pin"
            default 39
            help
                GPIO pin for touch interrupt (PENIRQ).
    endmenu

    menu "I2C Configuration (MPU6050)"
        config LEVELLER_I2C_SDA_PIN
            int "I2C SDA Pin"
            default 21
            help
                GPIO pin for I2C SDA (MPU6050).

        config LEVELLER_I2C_SCL_PIN
            int "I2C SCL Pin"
            default 22
            help
                GPIO pin for I2C SCL (MPU6050).

        config LEVELLER_I2C_FREQ_HZ
            int "I2C Frequency (Hz)"
            default 100000
            help
                I2C bus frequency (100kHz standard, 400kHz fast mode).
    endmenu

endmenu
```

## sdkconfig.defaults
```kconfig
# Leveller Project - ESP32 Default Configuration

# ESP32-WROOM-32 Configuration
CONFIG_IDF_TARGET="esp32"
CONFIG_IDF_TARGET_ESP32=y

# Serial flasher config
CONFIG_ESPTOOLPY_FLASHSIZE_4MB=y
CONFIG_ESPTOOLPY_FLASHMODE_DIO=y
CONFIG_ESPTOOLPY_FLASHFREQ_40M=y

# Partition Table
CONFIG_PARTITION_TABLE_SINGLE_APP=y

# FreeRTOS
CONFIG_FREERTOS_HZ=1000
CONFIG_FREERTOS_UNICORE=n

# ESP System Settings
CONFIG_ESP_MAIN_TASK_STACK_SIZE=8192
CONFIG_ESP_SYSTEM_EVENT_TASK_STACK_SIZE=4096

# SPI Configuration
CONFIG_SPI_MASTER_ISR_IN_IRAM=y

# LVGL Configuration
CONFIG_LV_COLOR_DEPTH_16=y
CONFIG_LV_COLOR_16_SWAP=n
CONFIG_LV_MEM_CUSTOM=n

# Enable larger fonts for LVGL
CONFIG_LV_FONT_MONTSERRAT_32=y
CONFIG_LV_FONT_MONTSERRAT_24=y
CONFIG_LV_FONT_MONTSERRAT_16=y
CONFIG_LV_FONT_MONTSERRAT_14=y

# ESP LCD
CONFIG_LCD_ENABLE_DEBUG_LOG=n

# Log output
CONFIG_LOG_DEFAULT_LEVEL_INFO=y
CONFIG_LOG_MAXIMUM_LEVEL_VERBOSE=y

# Component config
CONFIG_COMPILER_OPTIMIZATION_PERF=y
```
